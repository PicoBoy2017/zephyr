/*
 * Copyright (c) 2024 Analog Devices, Inc.
 *
 * SPDX-License-Identifier: Apache-2.0
 */

/dts-v1/;

#include <adi/max32/max32657.dtsi>
#include "max32657evkit_max32657_common.dtsi"

/ {
	 chosen {
		 zephyr,sram = &secure_ram;
		 zephyr,flash = &flash0;
		 zephyr,code-partition = &slot0_partition;
		 zephyr,bt-hci = &bt_hci_max32;
	 };

	/* This alias is provided for compatibility with samples */
	aliases {
		rtc = &rtc;
	};
};

&rtc {
	status = "okay";
	alarms-count = <1>;
	clock-source = <ADI_MAX32_PRPH_CLK_SRC_INRO>;
};
