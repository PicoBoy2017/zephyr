## boards/adi/eval_adin2111d1z/board.yml
```yaml
# Copyright (c) 2023-2024 Analog Devices, Inc.
# SPDX-License-Identifier: Apache-2.0

board:
  name: adi_eval_adin2111d1z
  vendor: adi
  socs:
    - name: max32690
```

## drivers/sensor/adi/max30123/Kconfig
```kconfig
# Single Channel, Ultra-Low Power Electrochemical Sensor AFE

# Copyright (c) 2024 Analog Devices, Inc.
#
# SPDX-License-Identifier: Apache-2.0

config MAX30123
	bool "MAX30123 Electrochemical Sensor"
	default y
	depends on DT_HAS_ADI_MAX30123_ENABLED
	select SPI
	help
	  Enable SPI-based driver for MAX30123 Electrochemical Sensor.
```

## dts/bindings/bluetooth/adi,max32-hci.yaml
```yaml
# Copyright 2024 Analog Devices, Inc.
#
# SPDX-License-Identifier: Apache-2.0

description: |
    Bluetooth HCI for ADI MAX32 devices

compatible: "adi,max32-hci"

include: bt-hci.yaml

properties:
  bt-hci-name:
    default: "BT MAX32"
  bt-hci-bus:
    default: "virtual"
```

## dts/bindings/i3c/adi,max32-i3c.yaml
```yaml
# Copyright (c) 2019 NXP
# Copyright (c) 2022 Intel Corporation
# Copyright (c) 2024 Analog Devices, Inc.
#
# SPDX-License-Identifier: Apache-2.0

description: ADI MAX32 I3C controller

compatible: "adi,max32-i3c"

include: [i3c-controller.yaml, pinctrl-device.yaml]

properties:
  reg:
    required: true

  interrupts:
    required: true

  i3c-od-scl-hz:
    type: int
    description: |
      Open Drain Frequency for the I3C controller. When undefined, use
      the controller default or as specified by the I3C specification.
```

## dts/bindings/rtc/adi,max32-rtc.yaml
```yaml
# Copyright (c) 2023 Analog Devices, Inc.
#
# SPDX-License-Identifier: Apache-2.0

description: ADI MAX32 compatible Real Timer Clock

compatible: "adi,max32-rtc"

include:
  - name: rtc-device.yaml

properties:
  reg:
    required: true

  clock-source:
    type: int
    enum: [4, 5]
    description: |
      Clock source to be used by the RTC peripheral. The following options
      are available:
      - 4: "ADI_MAX32_PRPH_CLK_SRC_ERTCO" External Real-Time Clock Oscillator
      - 5: "ADI_MAX32_PRPH_CLK_SRC_INRO" Internal Ring Oscillator
      The target device might not support all option please take a look on
      target device user guide
```

## samples/tfm_integration/tfm_regression_test/boards/max32657evkit_max32657_ns.conf
```kconfig
# Copyright (c) 2024 Analog Devices, Inc.
#
# SPDX-License-Identifier: Apache-2.0
#

CONFIG_TFM_PARTITION_PROTECTED_STORAGE=n
CONFIG_TFM_REGRESSION_S=n

CONFIG_TFM_IPC=n
CONFIG_TFM_ISOLATION_LEVEL=1
```

## soc/adi/max32/Kconfig.defconfig.max32655
```kconfig
# Analog Devices MAX32655 MCU

# Copyright (c) 2023-2024 Analog Devices, Inc.
# SPDX-License-Identifier: Apache-2.0

if SOC_MAX32655

config SYS_CLOCK_HW_CYCLES_PER_SEC
	default $(dt_node_int_prop_int,/clocks/clk_ipo,clock-frequency)

config NUM_IRQS
	default 110 if SOC_MAX32655_M4
	default 60 if SOC_MAX32655_RV32

if BT

config FPU
	default y

config MAIN_STACK_SIZE
	default 1536

endif # BT

endif # SOC_MAX32655
```

## soc/adi/max32/Kconfig.defconfig.max32657
```kconfig
# Analog Devices MAX32657 MCU

# Copyright (c) 2024 Analog Devices, Inc.
# SPDX-License-Identifier: Apache-2.0

if SOC_MAX32657

config SYS_CLOCK_HW_CYCLES_PER_SEC
	default $(dt_node_int_prop_int,/clocks/clk_ipo,clock-frequency)

config NUM_IRQS
	default 54

if BT

config FPU
	default y

config MAIN_STACK_SIZE
	default 1536

endif # BT

endif # SOC_MAX32657
```

## subsys/bluetooth/services/cgms/Kconfig.cgms
```kconfig
# Copyright (c) 2024 Analog Devices, Inc.
#
# SPDX-License-Identifier: Apache-2.0

# Bluetooth GATT Continuous Glucose Monitoring service
#
# For more information on CGM Service visit:
# https://www.bluetooth.com/wp-content/uploads/Files/Specification/HTML/CGMS_v1.0.2/out/en/index-en.html#UUID-6b7885fa-4b8f-fa82-07db-56a028af6f02
#
# For more information on GATT bit-field specification visit:
# https://btprodspecificationrefs.blob.core.windows.net/gatt-specification-supplement/GATT_Specification_Supplement.pdf

menuconfig BT_CGMS
	bool "GATT Continuous Glucose Monitoring service"

if BT_CGMS

config BT_CGMS_INTERVAL
	int "CGM Interval in Minutes"
	default 1
	help
	  Sets the interval in minutes between periodic measurements

config BT_CGMS_TYPE
	int "CGM Type Field"
	range 1 10
	help
	  Sets the Type field for the device

	  Values:
	    0 - Reserved
	    1 - Capilary Whole blood
	    2 - Capillary Plasma
	    3 - Venous Whole blood
	    4 - Venous Plasma
	    5 - Arterial Whole blood
	    6 - Arterial Plasma
	    7 - Undetermined Whole blood
	    8 - Undetermined Plasma
	    9 - Interstitial Fluid (ISF)
	    10 - Control Solution

config BT_CGMS_SAMPLE_LOCATION
	int "CGM Sample Location Field"
	range 1 15
	help
	  Sets the Sample Location field for the device

	  Values:
	    1 - Finger
	    2 - Alternate Site Test (AST)
	    3 - Earlobe
	    4 - Control Solution
	    5 - Subcutaneous tissue
	    6-14 - Reserved
	    15 - Sample Location value not available

config BT_CGMS_EXPECTED_RUNTIME
	int "Expected runtime in hours"
	help
	  Sets the CGM device' expected runtime in hours

config BT_CGMS_PRIO
	int "Priority level for CGM Service"
	default 3
	help
	  Sets the thread priority level for the CGM service

config BT_CGMS_STACK_SIZE
	int "Stack size for CGMS thread"
	default 1024
	help
	  Sets the stack size for the CGM Service thread

config BT_CGMS_RACP_STACK_SIZE
	int "Stack size for RACP helper thread"
	default 1024
	help
	  Sets the stack size for the RACP query helper thread

config BT_CGMS_RACP_WORKER_PRIO
	int "Priority level for RACP worker thread"
	default 4
	help
	  Sets the thread priority level of the RACP worker thread for querying CGM records

config BT_CGMS_RACP_WORKER_ABORT_TIMEOUT_MS
	int "Timeout in ms for waiting for the RACP worker thread to abort when signalled"
	default 1500
	help
	  How long to wait until reporting a failed abort when central attempts to abort an RACP action

choice
	prompt "Initial log level limit"
	default BT_CGMS_LOG_LEVEL_INF

config BT_CGMS_LOG_LEVEL_DEFAULT
	bool "System limit (LOG_MAX_LEVEL)"

config BT_CGMS_LOG_LEVEL_DBG
	bool "Debug"

config BT_CGMS_LOG_LEVEL_INF
	bool "Info"

config BT_CGMS_LOG_LEVEL_WRN
	bool "Warning"

config BT_CGMS_LOG_LEVEL_ERR
	bool "Error"

config BT_CGMS_LOG_LEVEL_NONE
	bool "None"

endchoice

config BT_CGMS_LOG_LEVEL
	int
	default 0 if BT_CGMS_LOG_LEVEL_NONE
	default 1 if BT_CGMS_LOG_LEVEL_ERR
	default 2 if BT_CGMS_LOG_LEVEL_WRN
	default 3 if BT_CGMS_LOG_LEVEL_INF
	default 4 if BT_CGMS_LOG_LEVEL_DBG
	default 5 if BT_CGMS_LOG_LEVEL_DEFAULT

endif # BT_CGMS
```

## subsys/usb/device_next/class/Kconfig.bt
```kconfig
# Copyright (c) 2023 Nordic Semiconductor ASA
# SPDX-License-Identifier: Apache-2.0

config USBD_BT_HCI
	bool "Bluetooth HCI USB Transport Layer"
	select BT
	select BT_HCI_RAW
	help
	  Bluetooth HCI USB Transport Layer

if USBD_BT_HCI

config USBD_BT_HCI_TX_THREAD_PRIORITY
	int "TX thread priority"
	default 8
	help
	  Bluetooth HCI USB Transport Layer TX thread priority.

config USBD_BT_HCI_TX_STACK_SIZE
	int "TX thread stack size"
	default 512
	help
	  Bluetooth HCI USB Transport Layer TX thread stack size.

config USBD_BT_HCI_RX_THREAD_PRIORITY
	int "RX thread priority"
	default 8
	help
	  Bluetooth HCI USB Transport Layer RX thread priority.

config USBD_BT_HCI_EP_EVENTS
	hex "USB BT HCI interrupt IN endpoint address" if !USBD_ASSIGN_EP_AUTO
	default 0x81
	help
	  USB BT HCI interrupt IN endpoint address.

config USBD_BT_HCI_EP_ACL_DATA_IN
	hex "USB BT HCI bulk IN endpoint address" if !USBD_ASSIGN_EP_AUTO
	default 0x82
	help
	  USB BT HCI bulk IN endpoint address.

config USBD_BT_HCI_EP_ACL_DATA_OUT
	hex "USB BT HCI bulk OUT endpoint address" if !USBD_ASSIGN_EP_AUTO
	default 0x02
	help
	  USB BT HCI bulk OUT endpoint address.

config USBD_BT_HCI_EP_VOICE_IN
	hex "USB BT HCI isochronous IN endpoint address" if !USBD_ASSIGN_EP_AUTO
	default 0x83
	help
	  USB BT HCI isochronous IN endpoint address.

config USBD_BT_HCI_EP_VOICE_OUT
	hex "USB BT HCI isochronous OUT endpoint address" if !USBD_ASSIGN_EP_AUTO
	default 0x03
	help
	  USB BT HCI isochronous OUT endpoint address.

module = USBD_BT_HCI
module-str = usbd bt hci
source "subsys/logging/Kconfig.template.log_config"

endif
```

## subsys/usb/device_next/class/Kconfig.cdc_acm
```kconfig
# Copyright (c) 2022 Nordic Semiconductor ASA
#
# SPDX-License-Identifier: Apache-2.0

config USBD_CDC_ACM_CLASS
	bool "USB CDC ACM implementation [EXPERIMENTAL]"
	depends on SERIAL
	depends on DT_HAS_ZEPHYR_CDC_ACM_UART_ENABLED
	select SERIAL_HAS_DRIVER
	select SERIAL_SUPPORT_INTERRUPT
	select RING_BUFFER
	select UART_INTERRUPT_DRIVEN
	help
	  USB device CDC ACM class implementation.

if USBD_CDC_ACM_CLASS

config USBD_CDC_ACM_STACK_SIZE
	int "USB CDC ACM workqueue stack size"
	default 1024
	help
	  USB CDC ACM workqueue stack size.

config USBD_CDC_ACM_IF0_INT_EP
	hex "USB CDC ACM interrupt IN endpoint address" if !USBD_ASSIGN_EP_AUTO
	default 0x81
	help
	  USB CDC ACM interrupt IN endpoint address.

config USBD_CDC_ACM_IF1_IN_EP
	hex "USB CDC ACM bulk IN endpoint address" if !USBD_ASSIGN_EP_AUTO
	default 0x82
	help
	  USB CDC ACM bulk IN endpoint address.

config USBD_CDC_ACM_IF1_OUT_EP
	hex "USB CDC ACM bulk OUT endpoint address" if !USBD_ASSIGN_EP_AUTO
	default 0x01
	help
	  USB CDC ACM bulk OUT endpoint address.

module = USBD_CDC_ACM
module-str = usbd cdc_acm
default-count = 1
source "subsys/logging/Kconfig.template.log_config"

endif
```

## subsys/usb/device_next/class/Kconfig.cdc_ecm
```kconfig
# Copyright (c) 2023 Nordic Semiconductor ASA
#
# SPDX-License-Identifier: Apache-2.0

config USBD_CDC_ECM_CLASS
	bool "USB CDC ECM implementation [EXPERIMENTAL]"
	default y
	depends on NET_L2_ETHERNET
	depends on DT_HAS_ZEPHYR_CDC_ECM_ETHERNET_ENABLED
	help
	  USB CDC Ethernet Control Model (ECM) implementation"

if USBD_CDC_ECM_CLASS

config USBD_CDC_ECM_IF0_INT_EP
	hex "USB CDC ECM interrupt IN endpoint address" if !USBD_ASSIGN_EP_AUTO
	default 0x81
	help
	  USB CDC ECM interrupt IN endpoint address.

config USBD_CDC_ECM_IF1_IN_EP
	hex "USB CDC ECM bulk IN endpoint address" if !USBD_ASSIGN_EP_AUTO
	default 0x82
	help
	  USB CDC ECM bulk IN endpoint address.

config USBD_CDC_ECM_IF1_OUT_EP
	hex "USB CDC ECM bulk OUT endpoint address" if !USBD_ASSIGN_EP_AUTO
	default 0x01
	help
	  USB CDC ECM bulk OUT endpoint address.

module = USBD_CDC_ECM
module-str = usbd cdc_ecm
default-count = 1
source "subsys/logging/Kconfig.template.log_config"
rsource "Kconfig.template.instances_count"

endif
```

## subsys/usb/device_next/class/Kconfig.cdc_ncm
```kconfig
# Copyright (c) 2024 Nordic Semiconductor ASA
#
# SPDX-License-Identifier: Apache-2.0

config USBD_CDC_NCM_CLASS
	bool "USB CDC NCM implementation [EXPERIMENTAL]"
	default y
	depends on NET_L2_ETHERNET
	depends on DT_HAS_ZEPHYR_CDC_NCM_ETHERNET_ENABLED
	select EXPERIMENTAL
	help
	  USB CDC Network Control Model (NCM) implementation

if USBD_CDC_NCM_CLASS

config USBD_CDC_NCM_MAX_DGRAM_PER_NTB
	int "Max number of received datagrams per NTB"
	range 0 $(UINT16_MAX)
	default 2
	help
	  How many datagrams we are able to receive per NTB.

config USBD_CDC_NCM_SUPPORT_NTB32
	bool "Support NTB32 format"
	help
	  Enable support for NTB32 format which allows larger
	  packet sizes.

config USBD_CDC_NCM_IF0_INT_EP
	hex "USB CDC NCM interrupt IN endpoint address" if !USBD_ASSIGN_EP_AUTO
	default 0x81
	help
	  USB CDC NCM interrupt IN endpoint address.

config USBD_CDC_NCM_IF1_IN_EP
	hex "USB CDC NCM bulk IN endpoint address" if !USBD_ASSIGN_EP_AUTO
	default 0x82
	help
	  USB CDC NCM bulk IN endpoint address.

config USBD_CDC_NCM_IF1_OUT_EP
	hex "USB CDC NCM bulk OUT endpoint address" if !USBD_ASSIGN_EP_AUTO
	default 0x01
	help
	  USB CDC NCM bulk OUT endpoint address.

module = USBD_CDC_NCM
module-str = usbd cdc_ncm
source "subsys/logging/Kconfig.template.log_config"

endif
```

## subsys/usb/device_next/class/Kconfig.hid
```kconfig
# Copyright (c) 2023 Nordic Semiconductor ASA
# SPDX-License-Identifier: Apache-2.0

menuconfig USBD_HID_SUPPORT
	bool "USB Human Interface Device support"
	default y
	depends on DT_HAS_ZEPHYR_HID_DEVICE_ENABLED
	help
	  Enables USB Human Interface Device support.

if USBD_HID_SUPPORT

config USBD_HID_IN_BUF_COUNT
	int "Number of buffers in the IN pool"
	range 1 256
	default 2
	help
	  Number of buffers in the IN pool per HID instance.

config USBD_HID_OUT_BUF_COUNT
	int "Number of buffers in the OUT pool"
	range 1 256
	default 2
	help
	  Number of buffers in the OUT pool per HID instance.

config USBD_HID_INIT_PRIORITY
	int "HID device init priority"
	default KERNEL_INIT_PRIORITY_DEVICE
	help
	  HID device initialization priority

config USBD_HID_IF0_IN_EP
	hex "USB HID interrupt IN endpoint address" if !USBD_ASSIGN_EP_AUTO
	default 0x81
	help
	  USB HID interrupt IN endpoint address.

config USBD_HID_IF0_OUT_EP
	hex "USB HID interrupt OUT endpoint address" if !USBD_ASSIGN_EP_AUTO
	default 0x01
	help
	  USB HID interrupt OUT endpoint address.

config USBD_HID_IF0_1_ALT_IN_EP
	hex "USB HID alternate interface interrupt IN endpoint address" if !USBD_ASSIGN_EP_AUTO
	default 0x81
	help
	  USB HID alternate interface interrupt IN endpoint address.

config USBD_HID_IF0_1_ALT_OUT_EP
	hex "USB HID alternate interface interrupt OUT endpoint address" if !USBD_ASSIGN_EP_AUTO
	default 0x01
	help
	  USB HID alternate interface interrupt OUT endpoint address.

module = USBD_HID
module-str = usbd hid
source "subsys/logging/Kconfig.template.log_config"

endif # USBD_HID_SUPPORT
```

## subsys/usb/device_next/class/Kconfig.loopback
```kconfig
# Copyright (c) 2022 Nordic Semiconductor ASA
#
# SPDX-License-Identifier: Apache-2.0

config USBD_LOOPBACK_CLASS
	bool "USB Loopback Class"
	help
	  USB device loopback class.
	  Primarily used for test and development purposes.

if USBD_LOOPBACK_CLASS

config USBD_LOOPBACK_IF0_IN_EP
	hex "USB Loopback bulk IN endpoint address" if !USBD_ASSIGN_EP_AUTO
	default 0x81
	help
	  USB Loopback bulk IN endpoint address.

config USBD_LOOPBACK_IF0_OUT_EP
	hex "USB Loopback bulk OUT endpoint address" if !USBD_ASSIGN_EP_AUTO
	default 0x01
	help
	  USB Loopback bulk OUT endpoint address.

config USBD_LOOPBACK_IF1_INT_IN_EP
	hex "USB Loopback interrupt IN endpoint address" if !USBD_ASSIGN_EP_AUTO
	default 0x82
	help
	  USB Loopback interrupt IN endpoint address.

config USBD_LOOPBACK_IF1_INT_OUT_EP
	hex "USB Loopback interrupt OUT endpoint address" if !USBD_ASSIGN_EP_AUTO
	default 0x02
	help
	  USB Loopback interrupt OUT endpoint address.

config USBD_LOOPBACK_IF2_ISO_IN_EP
	hex "USB Loopback isochronous IN endpoint address" if !USBD_ASSIGN_EP_AUTO
	default 0x83
	help
	  USB Loopback isochronous IN endpoint address.

config USBD_LOOPBACK_IF2_ISO_OUT_EP
	hex "USB Loopback isochronous OUT endpoint address" if !USBD_ASSIGN_EP_AUTO
	default 0x03
	help
	  USB Loopback isochronous OUT endpoint address.

config USBD_LOOPBACK_IF2_1_ISO_IN_EP
	hex "USB Loopback alternate interface isochronous IN endpoint address" if !USBD_ASSIGN_EP_AUTO
	default 0x83
	help
	  USB Loopback alternate interface isochronous IN endpoint address.

config USBD_LOOPBACK_IF2_1_ISO_OUT_EP
	hex "USB Loopback alternate interface isochronous OUT endpoint address" if !USBD_ASSIGN_EP_AUTO
	default 0x03
	help
	  USB Loopback alternate interface isochronous OUT endpoint address.

module = USBD_LOOPBACK
module-str = usbd loopback
default-count = 1
source "subsys/logging/Kconfig.template.log_config"

rsource "Kconfig.template.instances_count"
endif
```

## tests/drivers/spi/spi_loopback/boards/max32657fpga_max32657_ns.conf
```kconfig
#
# Copyright (c) 2024 Analog Devices, Inc.
#
# SPDX-License-Identifier: Apache-2.0
#
CONFIG_SPI_ASYNC=y
CONFIG_SPI_MAX32_INTERRUPT=y
CONFIG_SPI_LARGE_BUFFER_SIZE=2048
```
