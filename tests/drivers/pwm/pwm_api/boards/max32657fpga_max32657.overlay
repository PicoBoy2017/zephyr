/*
 * Copyright (c) 2024 Analog Devices, Inc.
 *
 * SPDX-License-Identifier: Apache-2.0
 */

/ {
	aliases {
		pwm-0 = &pwm0;
	};
};

&timer0 {
	status = "okay";
	pwm0: pwm {
		status = "okay";
		pinctrl-0 = <&tmr0a_p0_0>;
		pinctrl-names = "default";
	};
};
